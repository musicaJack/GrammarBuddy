## firmware/main/Kconfig.projbuild
```kconfig
menu "ChroneCore Weather (Seniverse)"

config CHRONECORE_WEATHER_CONFIG
    bool "Enable weather city list in WiFi provisioning page"
    default y
    help
        Enables weather city dropdown on the Advanced tab of the captive portal.

config CHRONECORE_WEATHER_API_KEY
    string "Seniverse API key"
    default ""
    help
        Seniverse API key. Leave empty to skip HTTPS weather requests.

config CHRONECORE_WEATHER_DEFAULT_CITY
    string "Default weather location id (pinyin)"
    default "shanghai"
    depends on CHRONECORE_WEATHER_CONFIG
    help
        Location id, e.g. beijing, kunming, shanghai.

endmenu

menu "GrammarBuddy"

config GRAMMARBUDDY_WIFI_SERVER_CONFIG
    bool "Backend server fields on WiFi provisioning page"
    default y
    help
        Show GrammarBuddy backend host and port on the WiFi captive portal main tab.

config GRAMMARBUDDY_DEFAULT_SERVER_HOST
    string "Default backend server host"
    default "192.168.1.100"
    depends on GRAMMARBUDDY_WIFI_SERVER_CONFIG

config GRAMMARBUDDY_DEFAULT_SERVER_PORT
    int "Default backend server port"
    default 8000
    range 1 65535
    depends on GRAMMARBUDDY_WIFI_SERVER_CONFIG

endmenu
```
